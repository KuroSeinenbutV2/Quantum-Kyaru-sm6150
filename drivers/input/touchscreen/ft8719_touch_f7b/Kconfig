## drivers/input/touchscreen/ft8719_touch_f7b/Kconfig
```kconfig
#
# Focaltech Touchscreen driver configuration
#
config TOUCHSCREEN_XIAOMI_FTS
        bool "Focaltech Touchscreen"
		depends on I2C
		default n
		help
		  Say Y here if you have Focaltech touch panel.
		  If unsure, say N.

config TOUCHSCREEN_FTS_XIAOMI_DIRECTORY
    string "Focaltech ts directory name"
    default "focaltech_touch"
    depends on TOUCHSCREEN_XIAOMI_FTS
```
